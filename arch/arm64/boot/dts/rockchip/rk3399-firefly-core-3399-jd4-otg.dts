// SPDX-License-Identifier: (GPL-2.0+ OR MIT)
/*
 * Firefly-Core-3399-JD4 OTG variant for One-KVM.
 *
 * The maskrom/flashing USB OTG port is routed to DWC3_1.
 * Keep dr_mode="otg" so the RK3399 PHY leaves the real ID pin
 * alone, default the dwc3 role switch to peripheral, and limit
 * the port to high-speed (the flashing port is USB2).
 */

#include "rk3399-firefly-core-3399-jd4.dts"

#include "rk3399-vpu.dtsi"

#include "rk3399-iep.dtsi"

&u2phy1_otg {
	status = "okay";
};

&usbdrd3_1 {
	status = "okay";
};

&usbdrd_dwc3_1 {
	dr_mode = "otg";
	usb-role-switch;
	role-switch-default-mode = "peripheral";
	maximum-speed = "high-speed";
	status = "okay";
};
